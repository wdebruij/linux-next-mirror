## Documentation/devicetree/bindings/misc/fsl,qoriq-mc.yaml
```yaml
# SPDX-License-Identifier: (GPL-2.0 OR BSD-2-Clause)
# Copyright 2020 NXP
%YAML 1.2
---
$id: http://devicetree.org/schemas/misc/fsl,qoriq-mc.yaml#
$schema: http://devicetree.org/meta-schemas/core.yaml#

maintainers:
  - Laurentiu Tudor <laurentiu.tudor@nxp.com>

title: Freescale Management Complex

description: |
  The Freescale Management Complex (fsl-mc) is a hardware resource
  manager that manages specialized hardware objects used in
  network-oriented packet processing applications. After the fsl-mc
  block is enabled, pools of hardware resources are available, such as
  queues, buffer pools, I/O interfaces. These resources are building
  blocks that can be used to create functional hardware objects/devices
  such as network interfaces, crypto accelerator instances, L2 switches,
  etc.

  For an overview of the DPAA2 architecture and fsl-mc bus see:
  Documentation/networking/device_drivers/freescale/dpaa2/overview.rst

  As described in the above overview, all DPAA2 objects in a DPRC share the
  same hardware "isolation context" and a 10-bit value called an ICID
  (isolation context id) is expressed by the hardware to identify
  the requester.

  The generic 'iommus' property is insufficient to describe the relationship
  between ICIDs and IOMMUs, so an iommu-map property is used to define
  the set of possible ICIDs under a root DPRC and how they map to
  an IOMMU.

  For generic IOMMU bindings, see:
  Documentation/devicetree/bindings/iommu/iommu.txt.

  For arm-smmu binding, see:
  Documentation/devicetree/bindings/iommu/arm,smmu.yaml.

  MC firmware binary images can be found here:
  https://github.com/NXP/qoriq-mc-binary

properties:
  compatible:
    const: fsl,qoriq-mc
    description:
      A Freescale Management Complex compatible with this binding must have
      Block Revision Registers BRR1 and BRR2 at offset 0x0BF8 and 0x0BFC in
      the MC control register region.

  reg:
    minItems: 1
    items:
      - description: the command portal for this machine
      - description:
          MC control registers. This region may not be present in some
          scenarios, such as in the device tree presented to a virtual
          machine.

  ranges:
    description: |
      A standard property. Defines the mapping between the child MC address
      space and the parent system address space.

      The MC address space is defined by 3 components:
                <region type> <offset hi> <offset lo>

      Valid values for region type are:
                  0x0 - MC portals
                  0x1 - QBMAN portals

  '#address-cells':
    const: 3

  '#size-cells':
    const: 1

  dpmacs:
    type: object
    description:
      The fsl-mc node may optionally have dpmac sub-nodes that describe the
      relationship between the Ethernet MACs which belong to the MC and the
      Ethernet PHYs on the system board.

    properties:
      '#address-cells':
        const: 1

      '#size-cells':
        const: 0

    patternProperties:
      "^dpmac@[0-9a-f]+$":
        type: object

        description:
          dpmac sub-node that describes the relationship between the
          Ethernet MACs which belong to the MC and the Ethernet PHYs
          on the system board.

        properties:
          compatible:
            const: "fsl,qoriq-mc-dpmac"

          reg:
            description: Specifies the id of the dpmac
            $ref: /schemas/types.yaml#/definitions/uint32
            minimum: 1
            maximum: 31

          phy-handle:
            $ref: /schemas/types.yaml#definitions/phandle
            description:
              Specifies the phandle to the PHY device node associated with
              this dpmac.

        required:
          - compatible
          - reg
          - phy-handle

  iommu-map:
    description: |
      Maps an ICID to an IOMMU and associated iommu-specifier data.

      The property is an arbitrary number of tuples of
      (icid-base, iommu, iommu-base, length).

      Any ICID i in the interval [icid-base, icid-base + length) is
      associated with the listed IOMMU, with the iommu-specifier
      (i - icid-base + iommu-base).

  msi-map:
    description: |
      Maps an ICID to a GIC ITS and associated msi-specifier data.

      The property is an arbitrary number of tuples of
      (icid-base, gic-its, msi-base, length).

      Any ICID in the interval [icid-base, icid-base + length) is
      associated with the listed GIC ITS, with the msi-specifier
      (i - icid-base + msi-base).

  msi-parent:
    deprecated: true
    description:
      Points to the MSI controller node handling message interrupts for the MC.

required:
  - compatible
  - reg
  - iommu-map
  - msi-map
  - ranges
  - '#address-cells'
  - '#size-cells'

additionalProperties: false

examples:
  - |
    soc {
      #address-cells = <2>;
      #size-cells = <2>;

      smmu: iommu@5000000 {
        compatible = "arm,mmu-500";
        #global-interrupts = <1>;
        #iommu-cells = <1>;
        reg = <0 0x5000000 0 0x800000>;
        stream-match-mask = <0x7c00>;
        interrupts = <0 13 4>,
                     <0 146 4>, <0 147 4>,
                     <0 148 4>, <0 149 4>,
                     <0 150 4>, <0 151 4>,
                     <0 152 4>, <0 153 4>;
      };

      fsl_mc: fsl-mc@80c000000 {
        compatible = "fsl,qoriq-mc";
        reg = <0x00000008 0x0c000000 0 0x40>,    /* MC portal base */
        <0x00000000 0x08340000 0 0x40000>; /* MC control reg */
        /* define map for ICIDs 23-64 */
        iommu-map = <23 &smmu 23 41>;
        /* define msi map for ICIDs 23-64 */
        msi-map = <23 &its 23 41>;
        #address-cells = <3>;
        #size-cells = <1>;

        /*
        * Region type 0x0 - MC portals
        * Region type 0x1 - QBMAN portals
        */
        ranges = <0x0 0x0 0x0 0x8 0x0c000000 0x4000000
                  0x1 0x0 0x0 0x8 0x18000000 0x8000000>;

        dpmacs {
          #address-cells = <1>;
          #size-cells = <0>;

          dpmac@1 {
            compatible = "fsl,qoriq-mc-dpmac";
            reg = <1>;
            phy-handle = <&mdio0_phy0>;
          };
        };
      };
    };
```
